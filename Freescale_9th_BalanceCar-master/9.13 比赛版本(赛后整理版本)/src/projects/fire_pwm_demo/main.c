/******************** (C) COPYRIGHT 2011 野火嵌入式开发工作室 ********************
 * 文件名       ：main.c
 * 描述         ：PWM实验
 *
 * 实验平台     ：野火kinetis开发板
 * 库版本       ：
 * 嵌入系统     ：
 *
 * 作者         ：野火嵌入式开发工作室
 * 淘宝店       ：http://firestm32.taobao.com
 * 技术支持论坛 ：http://www.ourdev.cn/bbs/bbs_list.jsp?bbs_id=1008
**********************************************************************************/


#include "common.h"
#include "include.h"


#if 1    //这里选择 0 或 1 来切换编译两个不同的main函数

/*************************************************************************
*                             野火嵌入式开发工作室
*                             PWM实验示波器简单测试
*
*  实验说明：野火PWM实验，用示波器测输出频率。
*
*  实验操作：这里用 FTM1_CH0 产生 PWM 脉冲波 ，即 PTA8 管脚。
*            把 PTA8 接入示波器
*
*  实验效果：可以测出频率为 35kHz
*
*  实验目的：测试 PWM 频率是否正确
*
*  修改时间：2012-2-29     已测试
*
*  备    注：FTM.h 里有各个FTM通道所对应管脚的表格，方便查看
*            占空比传递进入的参数，要根据 FTM_PRECISON 的定义来选择
*************************************************************************/
void  main()
{
    FTM_PWM_init(FTM1, CH0, 3000, 50); //初始化FTM1_CH0输出频率为35kHZ,占空比为50%的PWM ：FTM1_CH0对应PTA8口
    while(1)
    {
    }
}

#else


/*************************************************************************
*                             野火嵌入式开发工作室
*                               PWM实验LED测试
*
*  实验说明：野火PWM实验，用LED来测试占空比的变化。
*
*  实验操作：这里用 FTM1_CH0 产生 PWM 脉冲波
*            在 FTM.h 里，可以查到 FTM1_CH0 对应管脚为 PTA8
*            把 PTA8 接入 LED0，即 PTA8 和 PTD15 短接
*
*  实验效果：可以看到 LED0 由暗变亮，再突然暗，如此下去……
*
*  实验目的：测试 PWM 频率是否正确
*
*  修改时间：2012-2-29     已测试
*
*  备    注：野火Kinetis开发板的 LED0~3 ，分别接PTD15~PTD12 ，低电平点亮
*            FTM.h 里有各个FTM通道所对应管脚的表格，方便查看
*            占空比传递进入的参数，要根据 FTM_PRECISON 的定义来选择
*************************************************************************/
void  main()
{
    u32 i;
    FTM_PWM_init(FTM1, CH0, 35000, 100);     //FTM1_CH0初始化PWM ：PA8
    while(1)
    {
        for(i = 10; i > 1; i--)
        {
            FTM_PWM_Duty(FTM1, CH0, i * 10);  //改变占空比，逐渐变小 ,LED 逐渐变亮 （低电平点亮）
            time_delay_ms(100);               //延时100ms
        }
    }
}


#endif