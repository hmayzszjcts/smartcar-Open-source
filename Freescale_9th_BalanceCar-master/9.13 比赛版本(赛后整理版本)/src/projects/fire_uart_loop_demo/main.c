/******************** (C) COPYRIGHT 2011 野火嵌入式开发工作室 ********************
 * 文件名       ：main.c
 * 描述         ：UART串口查询接收实验
 *
 * 实验平台     ：野火kinetis开发板
 * 库版本       ：
 * 嵌入系统     ：
 *
 * 作者         ：野火嵌入式开发工作室
 * 淘宝店       ：http://firestm32.taobao.com
 * 技术支持论坛 ：http://www.ourdev.cn/bbs/bbs_list.jsp?bbs_id=1008
**********************************************************************************/
#include "common.h"
#include "include.h"


/*************************************************************************
*                             野火嵌入式开发工作室
*                             串口查询接收实验测试
*
*  实验说明：野火串口查询接收实验
*            野火串口默认为： UART1，TX接PTC4，RX接PTC3
*            k60_fire.h里定义了 printf 函数的输出设置：
*                #define FIRE_PORT           UART1
*                #define FIRE_BAUD           19200
*            这里的串口接收实验也使用 UART1 ，这样就可以使用 printf 函数。
*
*  实验操作：打开串口助手 ，设置波特率为 19200 。
*            串口线（经过MAX3232电平转换）：TX接PTC4，RX接PTC3 。
*            运行程序后，要在串口助手里，根据提示才发送数据，才能接收到数据。
*
*
*  实验效果：在串口助手里，可以看到输出如下信息：
*
*                     野火kinetis核心板测试程序
*       内核频率：200MHz	总线频率 ：66MHz
*       flex频率：66MHz 	flash频率：28MHz
*
*       Software Reset
*
*       K60-144pin      Silicon rev 1.2
*       Flash parameter version 0.0.7.0
*       Flash version ID 3.2.7.0
*       512 kBytes of P-flash	P-flash only
*       128 kBytes of RAM
*
*       串口查询接收实验
*
*       		——野火kinetis开发板
*
*       请发送数据：
*       你发送的字符为：f
*
*       快点发送字符哦，不等你的哦：
*       哈哈，赶得及哦！你发送的字符为：i
*
*       快点发送字符串哦，不等你的哦：
*       哈哈，赶得及哦！你发送的字符为：fire
*
*
*  实验目的：测试串口查询接收的函数
*
*  修改时间：2012-2-29     已测试
*
*  备    注：
*************************************************************************/

void  main(void)
{
    char ch;
    char str[20];

    uart_init(UART1, 19200);                    //初始化串口1，波特率为19200 ,波特率太大，容易不稳定
    printf("串口查询接收实验\n\n");             //发送提示信息
    printf("\t\t——野火kinetis开发板\n\n");

    while(1)
    {
        /**********    测试无限等待接收    **********/
        printf("请发送数据：\n");
        ch = uart_getchar(UART1);                //从串口1中等待接收数据
        printf("你发送的字符为：%c\n\n", ch);    //从串口1中发送出去

        time_delay_ms(1000);                     //延时1s

        /**********    测试有限等待接收一个字符    **********/
        printf("快点发送字符哦，不等你的哦：\n");
        if(uart_pendchar (UART1, &ch))  printf("哈哈，赶得及哦！你发送的字符为：%c\n\n", ch);   //从串口1中发送出去
        else                           printf("o(︶︿︶)o 唉，赶不及了！收不到你的数据。\n\n");     //从串口1中发送出去

        time_delay_ms(1000);


        /**********    测试有限等待接收字符串    **********/
        printf("快点发送字符串哦，不等你的哦：\n");
        if(uart_pendstr(UART1, str))
            printf("哈哈，赶得及哦！你发送的字符为：%s\n\n", str);    //从串口1中发送出去
        else
            printf("o(︶︿︶)o 唉，赶不及了！收不到你的数据。\n\n");     //从串口1中发送出去*/
    }
}
