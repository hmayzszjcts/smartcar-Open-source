/*
* @file         24C02.c
  * @brief      24C02相关函数实现
  * @author     xiao_fang
  * @version    v1.0
  * @date       2017-3-12
*/
#include "common.h"
#include "OLED.h"
#include "MKL_gpio.h"

/************************************************************************
OLED 一行可以显示16个字符，可以显示8行。
************************************************************************/

#define OLED_SCL  PTXn_T(PTB9,OUT)  // D0
#define OLED_SDA  PTXn_T(PTB7,OUT)  // D1
#define OLED_RST  PTXn_T(PTB11,OUT)  // RST
#define OLED_DC   PTXn_T(PTB8,OUT)  // DS
#define OLED_CS   PTXn_T(PTB10,OUT)  // CS

#define XLevelL		0x00
#define XLevelH		0x10
#define XLevel		((XLevelH&0x0F)*16+XLevelL)
#define Max_Column	128
#define Max_Row		64
#define	Brightness	0xCF

/*
4线SPI使用说明：
VBT 供内部DC-DC电压，3.3~4.3V，如果使用5V电压，为保险起见串一个100~500欧的电阻
VCC 供内部逻辑电压 1.8~6V
GND 地

BS0 低电平
BS1 低电平
BS2 低电平

CS  片选管脚
DC  命令数据选择管脚
RES 模块复位管脚
D0（SCLK） ，时钟脚，由MCU控制
D1（MOSI） ，主输出从输入数据脚，由MCU控制

D2 悬空
D3-D7 ， 低电平 ， 也可悬空，但最好设为低电平
RD  低电平 ，也可悬空，但最好设为低电平
RW  低电平 ，也可悬空，但最好设为低电平
RD  低电平 ，也可悬空，但最好设为低电平
*/

#define X_WIDTH 128
#define Y_WIDTH 64
//======================================
const uint8_t F6x8[][6] =
{
  { 0x00, 0x00, 0x00, 0x00, 0x00, 0x00 },   // sp
  { 0x00, 0x00, 0x00, 0x2f, 0x00, 0x00 },   // !
  { 0x00, 0x00, 0x07, 0x00, 0x07, 0x00 },   // "
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  { 0x14, 0x14, 0x14, 0x14, 0x14, 0x14 }    // horiz lines
};

//======================================================
// 128X64I液晶底层驱动[8X16]字体库
// 设计者: powerint
// 描  述: [8X16]西文字符的字模数据 (纵向取模,字节倒序)
// !"#$%&'()*+,-./0123456789:;<=>?@ABCDEFGHIJKLMNOPQRSTUVWXYZ[\]^_`abcdefghijklmnopqrstuvwxyz{|}~
//======================================================
const uint8_t F8X16[]=
{
  0x00,0x00,0x00,0x00,0x00,0x00,0x00,0x00,0x00,0x00,0x00,0x00,0x00,0x00,0x00,0x00,//  0
  0x00,0x00,0x00,0xF8,0x00,0x00,0x00,0x00,0x00,0x00,0x00,0x33,0x30,0x00,0x00,0x00,//! 1
  0x00,0x10,0x0C,0x06,0x10,0x0C,0x06,0x00,0x00,0x00,0x00,0x00,0x00,0x00,0x00,0x00,//" 2
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  0x00,0x06,0x01,0x01,0x02,0x02,0x04,0x04,0x00,0x00,0x00,0x00,0x00,0x00,0x00,0x00,//~ 94
  
};

uint8_t team_logo[768] ={
0x00,0x00,0x00,0x00,0x00,0x00,0x00,0x00,0x00,0x00,0x00,0x00,0x00,0x00,0x00,0x80,
0x80,0xC0,0x80,0x80,0x00,0x20,0x60,0x70,0xF0,0xF0,0xF0,0xF0,0xF0,0xF0,0xF0,0xF0,
0xF0,0xF0,0xF0,0xE0,0x80,0x00,0x40,0xC0,0x80,0x80,0x00,0x00,0x00,0x00,0x00,0x00,
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0x00,0x00,0x00,0x00,0x00,0x00,0x00,0x00,0x00,0x00,0x00,0x00,0x00,0x00,0x00,0x00,
};

void Dly_ms(uint16_t ms)
{
  uint16_t ii,jj;
  if (ms<1) ms=1;
  ms = ms*12 ;
  for(ii=0;ii<ms;ii++)
//    for(jj=0;jj<1335;jj++);  //16MHz--1ms
     for(jj=0;jj<4006;jj++);  //48MHz--1ms
  //for(jj=0;jj<5341;jj++);    //64MHz--1ms
}

void OLED_WrDat(uint8_t data)
{
  uint8_t i=8;
  
  OLED_DC=1;
  OLED_SCL=0;
  while(i--)
  {
    if(data&0x80){OLED_SDA=1;}
    else{OLED_SDA=0;}
    OLED_SCL=1;
    asm("nop");
    OLED_SCL=0;
    data<<=1;
  }
}
void OLED_Wr6Dat(uint8_t data)
{
  uint8_t i=6;
  
  OLED_DC=1;
  OLED_SCL=0;
  while(i--)
  {
    if(data&0x80){OLED_SDA=1;}
    else{OLED_SDA=0;}
    OLED_SCL=1;
    asm("nop");
    OLED_SCL=0;
    data<<=1;
  }
}
/*****************
点亮四个点
******************/
void OLED_Wr4Dat(uint8_t data)
{
  uint8_t i=4;
  
  OLED_DC=1;
  OLED_SCL=0;
  while(i--)
  {
    if(data&0x80){OLED_SDA=1;}
    else{OLED_SDA=0;}
    OLED_SCL=1;
    asm("nop");
    OLED_SCL=0;
    data<<=1;
  }
}

void OLED_WrCmd(uint8_t cmd)
{
  uint8_t i=8;

  OLED_DC=0;;
  OLED_SCL=0;;

  while(i--)
  {
    if(cmd&0x80){OLED_SDA=1;}
    else{OLED_SDA=0;}
    OLED_SCL=1;
    asm("nop");

    OLED_SCL=0;
    cmd<<=1;
  }
  
}
void OLED_Set_4Pos(uint8_t x, uint8_t y)
{
  OLED_WrCmd(0x40+y);
  OLED_WrCmd(((x&0xf0)>>4)|0x10);
  OLED_WrCmd((x&0x0f)|0x01);
}
void OLED_Set_Pos(uint8_t x, uint8_t y)
{
  OLED_WrCmd(0xb0+y);
  OLED_WrCmd(((x&0xf0)>>4)|0x10);
  OLED_WrCmd((x&0x0f)|0x01);
}
void OLED_Fill(uint8_t bmp_data)
{
  uint8_t y,x;
  
  for(y=0;y<8;y++)
  {
    OLED_WrCmd(0xb0+y);
    OLED_WrCmd(0x01);
    OLED_WrCmd(0x10);
    for(x=0;x<X_WIDTH;x++)
      OLED_WrDat(bmp_data);
  }
}
void OLED_CLS(void)
{
  uint8_t y,x;
  for(y=0;y<8;y++)
  {
    OLED_WrCmd(0xb0+y);
    OLED_WrCmd(0x01);
    OLED_WrCmd(0x10);
    for(x=0;x<X_WIDTH;x++)
      OLED_WrDat(0);
  }
}
void OLED_DLY_ms(uint16_t ms)
{
  vuint16 a;
  while(ms)
  {
    a=16000;
    while(a--);
    ms--;
  }
  return;
}

void OLED_Init(void)
{
  gpio_init (PTB7, GPO,HIGH);
  gpio_init (PTB8, GPO,HIGH);
  gpio_init (PTB9, GPO,HIGH);
  gpio_init (PTB10, GPO,HIGH);
  gpio_init (PTB11, GPO,LOW);
  
  OLED_SCL=1;
  OLED_CS = 0 ; ///使能信号端，拉低时正常使用
  OLED_RST=0;
  OLED_DLY_ms(50);
  OLED_RST=1;
  
  OLED_WrCmd(0xae);//--turn off oled panel
  OLED_WrCmd(0x00);//---set low column address
  OLED_WrCmd(0x10);//---set high column address
  OLED_WrCmd(0x40);//--set start line address  Set Mapping RAM Display Start Line (0x00~0x3F)
  OLED_WrCmd(0x81);//--set contrast control register
  OLED_WrCmd(0xcf); // Set SEG Output Current Brightness
  OLED_WrCmd(0xa1);//--Set SEG/Column Mapping     0xa0左右反置 0xa1正常
  OLED_WrCmd(0xc8);//Set COM/Row Scan Direction   0xc0上下反置 0xc8正常
  OLED_WrCmd(0xa6);//--set normal display
  OLED_WrCmd(0xa8);//--set multiplex ratio(1 to 64)
  OLED_WrCmd(0x3f);//--1/64 duty
  OLED_WrCmd(0xd3);//-set display offset	Shift Mapping RAM Counter (0x00~0x3F)
  OLED_WrCmd(0x00);//-not offset
  OLED_WrCmd(0xd5);//--set display clock divide ratio/oscillator frequency
  OLED_WrCmd(0x80);//--set divide ratio, Set Clock as 100 Frames/Sec
  OLED_WrCmd(0xd9);//--set pre-charge period
  OLED_WrCmd(0xf1);//Set Pre-Charge as 15 Clocks & Discharge as 1 Clock
  OLED_WrCmd(0xda);//--set com pins hardware configuration
  OLED_WrCmd(0x12);
  OLED_WrCmd(0xdb);//--set vcomh
  OLED_WrCmd(0x40);//Set VCOM Deselect Level
  OLED_WrCmd(0x20);//-Set Page Addressing Mode (0x00/0x01/0x02)
  OLED_WrCmd(0x02);//
  OLED_WrCmd(0x8d);//--set Charge Pump enable/disable
  OLED_WrCmd(0x14);//--set(0x10) disable
  OLED_WrCmd(0xa4);// Disable Entire Display On (0xa4/0xa5)
  OLED_WrCmd(0xa6);// Disable Inverse Display On (0xa6/a7)
  OLED_WrCmd(0xaf);//--turn on oled panel
  OLED_Fill(0x00);  //初始清屏
  OLED_Set_Pos(0,0);
  
   OLED_Fill(0x00);//黑屏 
   OLED_DLY_ms(10); 
  
}
//==============================================================
//函数名： void LCD_PutPixel(uint8_t x,uint8_t y)
//功能描述：绘制一个点（x,y）
//参数：真实坐标值(x,y),x的范围0～127，y的范围0～64
//返回：无
//==============================================================
void OLED_PutPixel(uint8_t x,uint8_t y)
{
  uint8_t data1;  //data1当前点的数据
  
  OLED_Set_Pos(x,y);
  data1 = 0x01<<(y%8);
  OLED_WrCmd(0xb0+(y>>3));
  OLED_WrCmd(((x&0xf0)>>4)|0x10);
  OLED_WrCmd((x&0x0f)|0x00);
  OLED_WrDat(data1);
}
//==============================================================
//函数名： void LCD_Rectangle(uint8_t x1,uint8_t y1,
//                   uint8_t x2,uint8_t y2,uint8_t color,uint8_t gif)
//功能描述：绘制一个实心矩形
//参数：左上角坐标（x1,y1）,右下角坐标（x2，y2）
//      其中x1、x2的范围0～127，y1，y2的范围0～63，即真实坐标值
//返回：无
//==============================================================
void OLED_Rectangle(uint8_t x1,uint8_t y1,uint8_t x2,uint8_t y2,uint8_t gif)
{
  uint8_t n;
  
  OLED_Set_Pos(x1,y1>>3);
  for(n=x1;n<=x2;n++)
  {
    OLED_WrDat(0x01<<(y1%8));
    if(gif == 1) 	
      OLED_DLY_ms(50);
  }
  OLED_Set_Pos(x1,y2>>3);
  for(n=x1;n<=x2;n++)
  {
    OLED_WrDat(0x01<<(y2%8));
    if(gif == 1) 	
      OLED_DLY_ms(5);
  }
  
}
//==============================================================
//函数名：LCD_P6x8Str(uint8_t x,uint8_t y,uint8_t *p)
//功能描述：写入一组标准ASCII字符串
//参数：显示的位置（x,y），y为页范围0～7，要显示的字符串
//返回：无
//==============================================================
void OLED_P6x8Str(uint8_t x,uint8_t y,uint8_t ch[])
{
  uint8_t c=0,i=0,j=0;
  while (ch[j]!='\0')
  {
    c =ch[j]-32;
    if(x>126){x=0;y++;}
    OLED_Set_Pos(x,y);
    for(i=0;i<6;i++)
      OLED_WrDat(F6x8[c][i]);
    x+=6;
    j++;
  }
}
//==============================================================
//函数名：LCD_P8x16Str(uint8_t x,uint8_t y,uint8_t *p)
//功能描述：写入一组标准ASCII字符串
//参数：显示的位置（x,y），y为页范围0～7，要显示的字符串
//返回：无
//==============================================================
void OLED_P8x16Str(uint8_t x,uint8_t y,uint8_t ch[])
{
  uint8_t c=0,i=0,j=0;
  
  while (ch[j]!='\0')
  {
    c =ch[j]-32;
    if(x>120){x=0;y++;}
    OLED_Set_Pos(x,y);
    for(i=0;i<8;i++)
      OLED_WrDat(F8X16[c*16+i]);
    OLED_Set_Pos(x,y+1);
    for(i=0;i<8;i++)
      OLED_WrDat(F8X16[c*16+i+8]);
    x+=8;
    j++;
  }
}


/*********************************************************** 
* 函数功能：数字转换成ACSII
* 入口参数：hex :   需要显示的数
*           Print : 转换后的数组指针
* 出口参数：无 
* 修改时间: 2014-08-18
* 备 注： 
***********************************************************/

void OLED_HEXACSII(uint16_t hex,uint8_t* Print)
{
  uint8_t hexcheck ;
  uint8_t TEMP ;
  TEMP = 6 ;
  Print[TEMP ]='\0';
  while(TEMP)
  {
    TEMP -- ;
    hexcheck  =  hex%10 ;
    hex   /=10 ;
    Print[TEMP ]  = hexcheck + 0x30 ;
  }
  
}

/*********************************************************** 
* 函数名称：OLED_Display_Num 
* 函数功能：数字显示
* 入口参数：x : 角度显示字符
*           y : 加速度显示字符
*          num: 显示的数字
* 出口参数：无 
* 修改时间: 2014-08-18
* 备 注： 
***********************************************************/
void OLED_Print_Num(uint8_t x, uint8_t y, uint16_t num)
{
  uint8_t *ch1,ch[7];
  uint8_t ii=0;
  
  OLED_HEXACSII(num,ch);
  
  while(ch[ii]==0x30)
  {
      ii++;
  }
  
  ch1 =&ch[ii];
  
  while(*ch1 != '\0')
  {
      OLED_P8x16Str(x, y, ch1);	//显示数字
      x += 8;
     ch1++;
  }
}
//==============================================================
//函数名： void Draw_BMP(uint8_t x,uint8_t y)
//功能描述：显示BMP图片128×64
//参数：起始点坐标(x,y),x的范围0～127，y为页的范围0～7
//返回：无
//==============================================================
void Draw_BMP(uint8_t x0,uint8_t y0,uint8_t x1,uint8_t y1,uint8_t bmp[])
{
  uint16_t ii=0;
  uint8_t x,y;
  
  if(y1%8==0) y=y1/8;
  else y=y1/8+1;
  for(y=y0;y<=y1;y++)
  {
    OLED_Set_Pos(x0,y);
    for(x=x0;x<x1;x++)
    {
      OLED_WrDat(bmp[ii++]);
    }
  }
}


void Draw_team_logo(void)
{
  uint16_t ii=0;
  uint8_t x,y;
  
  for(y=2;y<8;y++)
  {
    OLED_Set_Pos(0,y);
    for(x=0;x<128;x++)
    {
      OLED_WrDat(team_logo[ii++]);
    }
  }
}

void draw_sensor_value(uint16 * sensor_value)
{
    OLED_Print_Num(0, 0, sensor_value[0]);
    OLED_Print_Num(30, 0, sensor_value[2]);
    OLED_Print_Num(60, 0, sensor_value[3]);
    OLED_Print_Num(90, 0, sensor_value[5]);
}